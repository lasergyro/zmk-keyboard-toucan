// Settings borrowed from the Toucan reference config for keyboard-driven mouse controls.
// Override ZMK defaults before pointing.h uses them (pointing.h uses #ifndef guards).
#undef ZMK_POINTING_DEFAULT_MOVE_VAL
#define ZMK_POINTING_DEFAULT_MOVE_VAL 600
#undef ZMK_POINTING_DEFAULT_SCRL_VAL
#define ZMK_POINTING_DEFAULT_SCRL_VAL 20

#include <dt-bindings/zmk/pointing.h>

&mmv {
  acceleration-exponent = <1>;
  time-to-max-speed-ms = <500>;
  delay-ms = <0>;
};

&msc {
  acceleration-exponent = <0>;
  time-to-max-speed-ms = <300>;
  delay-ms = <0>;
};

#define U_MS_U &mmv MOVE_UP
#define U_MS_D &mmv MOVE_DOWN
#define U_MS_L &mmv MOVE_LEFT
#define U_MS_R &mmv MOVE_RIGHT
#define U_WH_U &msc SCRL_UP
#define U_WH_D &msc SCRL_DOWN
#define U_WH_L &msc SCRL_LEFT
#define U_WH_R &msc SCRL_RIGHT
