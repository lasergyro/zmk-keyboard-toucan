## Kconfig
```kconfig
menu "Toucan custom behaviors"

config TOUCAN_DEBUG_RPC
    bool "Enable Toucan debug RPC over USB CDC ACM"
    default n

config TOUCAN_DEBUG_QUARANTINE
    bool "Enable Toucan debug quarantine mode"
    default y if TOUCAN_DEBUG_RPC

config TOUCAN_SLEEP_LOG
    bool "Record a persistent rotating log of active/idle/charging durations"
    default y
    depends on SETTINGS
    help
      Per-half rotating log of activity-state (active/idle) and charging
      durations, stored as a page-ring in the NVS settings partition so it
      survives deep sleep. Read it back over the debug RPC `sleeplog` command.

DT_COMPAT_ZMK_BEHAVIOR_TOUCAN_OUTPUT_MODE := zmk,behavior-toucan-output-mode

config ZMK_BEHAVIOR_TOUCAN_OUTPUT_MODE
    bool
    default $(dt_compat_enabled,$(DT_COMPAT_ZMK_BEHAVIOR_TOUCAN_OUTPUT_MODE))

DT_COMPAT_ZMK_BEHAVIOR_TOUCAN_TEXT_SYMBOL := zmk,behavior-toucan-text-symbol

config ZMK_BEHAVIOR_TOUCAN_TEXT_SYMBOL
    bool
    default $(dt_compat_enabled,$(DT_COMPAT_ZMK_BEHAVIOR_TOUCAN_TEXT_SYMBOL))

DT_COMPAT_ZMK_BEHAVIOR_TOUCAN_CLIPBOARD := zmk,behavior-toucan-clipboard

config ZMK_BEHAVIOR_TOUCAN_CLIPBOARD
    bool
    default $(dt_compat_enabled,$(DT_COMPAT_ZMK_BEHAVIOR_TOUCAN_CLIPBOARD))

endmenu
```

## config/west.yml
```yaml
manifest:
  defaults:
    revision: v0.3
  remotes:
    - name: zmkfirmware
      url-base: https://github.com/zmkfirmware
    - name: urob
      url-base: https://github.com/urob
    - name: petejohanson
      url-base: https://github.com/petejohanson/
    - name: caksoylar
      url-base: https://github.com/caksoylar
    - name: geeksville
      url-base: https://github.com/geeksville
    - name: oleksandrmaslov
      url-base: https://github.com/oleksandrmaslov
  projects:
    - name: zmk
      url: ../../external/zmk
      revision: HEAD
      import: app/west.yml
    - name: zmk-helpers
      remote: urob
      revision: v0.3
      path: modules/zmk/helpers
    - name: zmk-leader-key
      remote: urob
      revision: v0.3
      path: modules/zmk/leader-key
    - name: zmk-unicode
      remote: urob
      revision: v0.3
      path: modules/zmk/unicode
    - name: zmk-rgbled-widget
      remote: caksoylar
      revision: v0.3
    - name: zmk-pointing-acceleration
      remote: oleksandrmaslov
      revision: main
  self:
    path: config
```

## dts/bindings/behaviors/toucan,behavior-clipboard.yaml
```yaml
# Copyright (c) 2026
# SPDX-License-Identifier: MIT

description: Toucan OS-aware clipboard behavior (cut/copy/paste)

compatible: "zmk,behavior-toucan-clipboard"

include: one_param.yaml
```

## dts/bindings/behaviors/toucan,behavior-output-mode.yaml
```yaml
# Copyright (c) 2026
# SPDX-License-Identifier: MIT

description: Toucan per-endpoint text output mode behavior

compatible: "zmk,behavior-toucan-output-mode"

include: one_param.yaml
```

## dts/bindings/behaviors/toucan,behavior-pad-layer-hold.yaml
```yaml
# Copyright (c) 2026
# SPDX-License-Identifier: MIT

description: Toucan PAD layer hold behavior

compatible: "zmk,behavior-toucan-pad-layer-hold"

include: one_param.yaml
```

## dts/bindings/behaviors/toucan,behavior-pad-mouse-key-press.yaml
```yaml
# Copyright (c) 2026
# SPDX-License-Identifier: MIT

description: Toucan PAD mouse key press behavior

compatible: "zmk,behavior-toucan-pad-mouse-key-press"

include: one_param.yaml
```

## dts/bindings/behaviors/toucan,behavior-text-symbol.yaml
```yaml
# Copyright (c) 2026
# SPDX-License-Identifier: MIT

description: Toucan text symbol behavior

compatible: "zmk,behavior-toucan-text-symbol"

include: one_param.yaml
```

## dts/bindings/input_processors/toucan,input-processor-pad-activity.yaml
```yaml
# Copyright (c) 2026
# SPDX-License-Identifier: MIT

description: Toucan PAD touch activity input processor

compatible: "zmk,input-processor-toucan-pad-activity"

include: ip_zero_param.yaml
```
